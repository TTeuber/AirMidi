## firmware/components/board/Kconfig
```kconfig
menu "airmidi board"

    choice AIRMIDI_BOARD
        prompt "Board"
        default AIRMIDI_BOARD_XIAO_C6 if IDF_TARGET_ESP32C6
        default AIRMIDI_BOARD_XIAO_S3 if IDF_TARGET_ESP32S3
        help
            The receiver PCB (rev A) with the XIAO module it carries. Selects the pin table and the board init.

        config AIRMIDI_BOARD_XIAO_C6
            bool "receiver rev A + XIAO ESP32-C6"
            depends on IDF_TARGET_ESP32C6

        config AIRMIDI_BOARD_XIAO_S3
            bool "receiver rev A + XIAO ESP32-S3"
            depends on IDF_TARGET_ESP32S3

        config AIRMIDI_BOARD_DEVKITC_S3
            bool "ESP32-S3-DevKitC-1 on its own"
            depends on IDF_TARGET_ESP32S3
            help
                A bare dev kit on its native USB port: USB MIDI, the radios and the web UI, no TRS jacks wired
                (UART MIDI on GPIO17/18 if you add them), no battery, the BOOT button as the box's button.

        config AIRMIDI_BOARD_DIRECT_S3
            bool "The receiver's rev A jacks, driven straight from the S3"
            depends on IDF_TARGET_ESP32S3
            help
                A bare ESP32-S3 board with the receiver's rev A TRS jacks on its own pins, driven straight from the
                chip: TRS TIP (MIDI OUT data, the board's J2) on the S3's GPIO14, TRS RING (the port's type switch)
                on the S3's GPIO15, and TRS IN (MIDI IN, the board's J3) on the S3's GPIO21 via the 6N138. The port
                defaults to Type A: the RING is held high, so the TIP is the data out. Type B (the other direction)
                is pending.
    endchoice

endmenu
```

## firmware/components/ota/Kconfig
```kconfig
menu "airmidi updates"
    config AIRMIDI_UPDATE_BASE_URL
        string "Where releases are published"
        default "https://github.com/TTeuber/AirMidi/releases/latest/download"
        help
            The box reads <base>/manifest.json ({"version": ..., "images": {"c6": file, "s3": file}}) and downloads
            <base>/<file> for its board. GitHub's "latest/download" URL redirects to the newest release's assets.
endmenu
```
